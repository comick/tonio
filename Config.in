## configs/tonio_pi3_defconfig
```kconfig
BR2_arm=y
BR2_cortex_a53=y
BR2_ARM_FPU_NEON_VFPV4=y
BR2_CCACHE=y
BR2_PACKAGE_HOST_LINUX_HEADERS_CUSTOM_4_19=y
BR2_TOOLCHAIN_BUILDROOT_WCHAR=y
BR2_TOOLCHAIN_BUILDROOT_CXX=y
BR2_TARGET_GENERIC_HOSTNAME="tonio"
BR2_TARGET_GENERIC_ISSUE="Tonio is the free juke-box software for children and beyond!"
BR2_ROOTFS_DEVICE_CREATION_DYNAMIC_MDEV=y
BR2_TARGET_GENERIC_ROOT_PASSWD="tonio"
BR2_SYSTEM_DHCP="wlan0"
BR2_ROOTFS_OVERLAY="$(BR2_EXTERNAL_TONIO_PI3_PATH)/board/raspberrypi3/rootfs_overlay"
BR2_ROOTFS_POST_BUILD_SCRIPT="$(BR2_EXTERNAL_TONIO_PI3_PATH)/board/raspberrypi3/post-build.sh"
BR2_ROOTFS_POST_IMAGE_SCRIPT="$(BR2_EXTERNAL_TONIO_PI3_PATH)/board/raspberrypi3/post-image.sh"
BR2_ROOTFS_POST_SCRIPT_ARGS="--add-pi3-miniuart-bt-overlay"
BR2_LINUX_KERNEL=y
BR2_LINUX_KERNEL_CUSTOM_TARBALL=y
BR2_LINUX_KERNEL_CUSTOM_TARBALL_LOCATION="$(call github,raspberrypi,linux,64d0a9870ac14d5eb5253f67d984ae348eec1393)/linux-64d0a9870ac14d5eb5253f67d984ae348eec1393.tar.gz"
BR2_LINUX_KERNEL_USE_CUSTOM_CONFIG=y
BR2_LINUX_KERNEL_CUSTOM_CONFIG_FILE="$(BR2_EXTERNAL_TONIO_PI3_PATH)/board/raspberrypi3/linux.config"
BR2_LINUX_KERNEL_DTS_SUPPORT=y
BR2_LINUX_KERNEL_INTREE_DTS_NAME="bcm2710-rpi-3-b bcm2710-rpi-3-b-plus bcm2710-rpi-cm3"
BR2_LINUX_KERNEL_NEEDS_HOST_OPENSSL=y
BR2_PACKAGE_ALSA_UTILS=y
# BR2_PACKAGE_ALSA_UTILS_ALSACTL is not set
# BR2_PACKAGE_ALSA_UTILS_ALSAMIXER is not set
BR2_PACKAGE_ALSA_UTILS_AMIXER=y
BR2_PACKAGE_MPG123=y
BR2_PACKAGE_RPI_FIRMWARE=y
BR2_PACKAGE_RPI_WIFI_FIRMWARE=y
BR2_PACKAGE_OPUS=y
BR2_PACKAGE_CA_CERTIFICATES=y
BR2_PACKAGE_GNUTLS=y
BR2_PACKAGE_AVAHI=y
BR2_PACKAGE_AVAHI_DAEMON=y
BR2_PACKAGE_AVAHI_LIBDNSSD_COMPATIBILITY=y
BR2_PACKAGE_DNSMASQ=y
# BR2_PACKAGE_DNSMASQ_TFTP is not set
BR2_PACKAGE_DROPBEAR=y
# BR2_PACKAGE_DROPBEAR_CLIENT is not set
# BR2_PACKAGE_DROPBEAR_SMALL is not set
BR2_PACKAGE_HOSTAPD=y
BR2_PACKAGE_IW=y
BR2_PACKAGE_WIRELESS_TOOLS=y
BR2_PACKAGE_WIRELESS_TOOLS_LIB=y
BR2_PACKAGE_WPA_SUPPLICANT=y
BR2_TARGET_ROOTFS_EXT2=y
BR2_TARGET_ROOTFS_EXT2_4=y
BR2_TARGET_ROOTFS_EXT2_SIZE="32M"
# BR2_TARGET_ROOTFS_TAR is not set
BR2_PACKAGE_HOST_DOSFSTOOLS=y
BR2_PACKAGE_HOST_GENIMAGE=y
BR2_PACKAGE_HOST_MTOOLS=y
BR2_PACKAGE_TONIO=y
```

## package/tonio/Config.in
```kconfig
menuconfig BR2_PACKAGE_TONIO
    bool "tonio"
    select BR2_PACKAGE_LIBGPIOD2
    select BR2_PACKAGE_LIBGPIOD2_TOOLS
    select BR2_PACKAGE_ALSA_LIB
    select BR2_PACKAGE_LIBMICROHTTPD
    select BR2_PACKAGE_HOST_PKGCONF
    select BR2_PACKAGE_LIBCONFUSE
    select BR2_PACKAGE_IW
    help
        Tonio is the free juke-box software for children and beyond!

if BR2_PACKAGE_TONIO
    choice
        prompt "Media backend"
        default BR2_PACKAGE_TONIO_MEDIA_OPUS
        help
            Select the media playback backend for Tonio.

        config BR2_PACKAGE_TONIO_MEDIA_OPUS
            bool "opusfile (lightweight, no VLC)"
            select BR2_PACKAGE_OPUSFILE
            help
                Use the opusfile library + ALSA PCM for Opus audio playback.
                This is a lightweight backend that does not require VLC.

        config BR2_PACKAGE_TONIO_MEDIA_VLC
            bool "VLC (full libvlc)"
            select BR2_PACKAGE_VLC
            help
                Use the full VLC media backend via libvlc.
                Requires VLC and all its dependencies.

    endchoice
endif
```
